## config/west.yml
```yaml
manifest:
  remotes:
    - name: zmkfirmware
      url-base: https://github.com/manna-harbour
  projects:
    - name: zmk
      remote: zmkfirmware
      revision: zen
      import: app/west.yml
  self:
    path: config
```
